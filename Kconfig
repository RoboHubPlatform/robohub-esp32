## Kconfig
```kconfig
# robohub-esp32 Kconfig
# Platform-level configuration for ESP32 boards.

menu "RoboHub ESP32 Platform"

config RH_HAL_GPIO
    bool "GPIO HAL"
    default y
    help
      Enable GPIO peripheral HAL implementation.

config RH_HAL_I2C
    bool "I2C HAL"
    default y
    help
      Enable I2C peripheral HAL implementation.

config RH_HAL_SPI
    bool "SPI HAL"
    default y
    help
      Enable SPI peripheral HAL implementation.

config RH_HAL_UART
    bool "UART HAL"
    default y
    help
      Enable UART peripheral HAL implementation.

config RH_HAL_TIMER
    bool "Timer HAL"
    default y
    help
      Enable Timer HAL implementation.

config RH_HAL_RS485
    bool "RS485 HAL"
    default n
    help
      Enable RS485 HAL implementation.

endmenu
```

## boards/lolin32-lite/Kconfig
```kconfig
# lolin32-lite board configuration

config RH_BOARD_LOLIN32_LITE
    bool "LOLIN32 Lite"
    default y
    help
      WEMOS LOLIN32 Lite: an ESP32-WROOM-32 with 4 MB of flash.

config RH_CONSOLE_UART_NUM
    int "Console UART"
    default 0
    help
      Which UART the console is on. UART0 is the one the ROM prints to and the
      one the USB-serial chip is wired to.
```

## examples/c/hello_world/Kconfig
```kconfig
# hello_world configuration

config RH_HAL_GPIO
    bool "GPIO"
    default y

config RH_HAL_TIMER
    bool "Timer"
    default y

config RH_BOARD_LOLIN32_LITE
    bool "LOLIN32 Lite"
    default y
```
